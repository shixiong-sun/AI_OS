## esp32/main/Kconfig.projbuild
```kconfig
menu "AI-OS Configuration"

    menu "WiFi Configuration"
        config AIOS_WIFI_SSID
            string "WiFi SSID"
            default "myssid"
            help
                Your WiFi network name.

        config AIOS_WIFI_PASSWORD
            string "WiFi Password"
            default "mypassword"
            help
                Your WiFi network password.
    endmenu

    menu "Server Configuration"
        config AIOS_SERVER_HOST
            string "Server Host"
            default "192.168.1.100"
            help
                AI-OS Server IP address.

        config AIOS_SERVER_PORT
            int "Server Port"
            default 8000
            range 1 65535
            help
                AI-OS Server port.
    endmenu

    menu "I2S Microphone Configuration"
        config AIOS_I2S_BCLK_PIN
            int "I2S BCLK GPIO"
            default 4
            range 0 48
            help
                I2S Bit Clock pin (connect to INMP441 BCLK).

        config AIOS_I2S_LRCK_PIN
            int "I2S LRCK (WS) GPIO"
            default 5
            range 0 48
            help
                I2S Left/Right Clock (Word Select) pin (connect to INMP441 LRCK).

        config AIOS_I2S_DIN_PIN
            int "I2S DIN (Data In) GPIO"
            default 6
            range 0 48
            help
                I2S Data In pin (connect to INMP441 DOUT).

        config AIOS_AUDIO_DURATION_MS
            int "Recording duration (ms)"
            default 3000
            range 1000 10000
            help
                Duration of each audio recording in milliseconds.
    endmenu

endmenu
```
